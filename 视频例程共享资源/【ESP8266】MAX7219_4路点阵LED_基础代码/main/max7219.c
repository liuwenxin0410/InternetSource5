#include "freertos/FreeRTOS.h"
#include "freertos/task.h"
#include "freertos/queue.h"

#include "esp_log.h"
#include "esp_system.h"

#include "max7219.h"

static const char *TAG = "MAX7219";

void MAX7219_Write_Serial_Data(uint16_t Data)
{
	uint8_t i = 0;

	for(i=0; i<16; i++){
		MAX7219_SCLK_Clr();
		
		if(Data&0x8000){
			MAX7219_SDIN_Set();
		}else{
			MAX7219_SDIN_Clr();
		}

		Data = Data<<1;

		MAX7219_SCLK_Set();
	}
}

/*
* Cnt: Count of MAX7291
* Addr: MAX7291 Register address
* Data: Write data to register
*/
void MAX7219_Write(uint8_t Cnt, uint8_t Addr, uint8_t Data)
{
	uint8_t i = 0;
	uint16_t dout = (Addr<<8|Data);
	MAX7219_CS_Clr();
	for(i=0; i<Cnt; i++){
		MAX7219_Write_Serial_Data(dout);
	}
	MAX7219_CS_Set();
}

/*
* Cnt: Count of MAX7291
*/
void MAX7219_Init(uint8_t Cnt)
{
	MAX7219_Write(Cnt, MAX7219_REG_DECODE_MODE, 0x00);       	//No decode for digits 7�C0
	MAX7219_Write(Cnt, MAX7219_REG_INTENSITY, 0x04);       		//Intensity: 0x00 ~ 0x0F
	MAX7219_Write(Cnt, MAX7219_REG_SCAN_LIMIT, 0x07);       		//Display digits 0 1 2 3 4 5 6 7
	MAX7219_Write(Cnt, MAX7219_REG_SHUTDOWN, 0x01);       			//Shutdown Mode(0x00) Normal Operation(0x01)
	MAX7219_Write(Cnt, MAX7219_REG_DISPLAY_TEST, 0x00);       	//Normal Operation(0x00) Display Test Mode(0x01)
}

void MAX7219_Test_Self(void)
{
	
	uint8_t i = 0, j = 0;
	
	uint8_t disp1[38][8]={
		{0x3C,0x42,0x42,0x42,0x42,0x42,0x42,0x3C},//0
		{0x10,0x18,0x14,0x10,0x10,0x10,0x10,0x10},//1
		{0x7E,0x2,0x2,0x7E,0x40,0x40,0x40,0x7E},//2
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		{0xFE,0xBA,0x92,0xBA,0x92,0x9A,0xBA,0xFE},//��
	};

	ESP_LOGE(TAG, "MAX7219_Test_Self");
	
	MAX7219_Init(MAX7219_COUNT);

	for(j=0; j<38; j++){
		for(i=1; i<9; i++){
			MAX7219_Write(MAX7219_COUNT, i, disp1[j][i-1]);
		}
		vTaskDelay(1500 / portTICK_RATE_MS);
	}
}


